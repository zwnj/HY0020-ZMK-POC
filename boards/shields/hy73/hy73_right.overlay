#include "hy73.dtsi"

/* Right local column 0 maps to global column 6. */
&default_transform {
    col-offset = <6>;
};

&kscan0 {
    row-gpios =
        <&gpio0 2 (GPIO_ACTIVE_HIGH | GPIO_PULL_DOWN)>,
        <&gpio0 3 (GPIO_ACTIVE_HIGH | GPIO_PULL_DOWN)>,
        <&gpio0 4 (GPIO_ACTIVE_HIGH | GPIO_PULL_DOWN)>,
        <&gpio0 5 (GPIO_ACTIVE_HIGH | GPIO_PULL_DOWN)>,
        <&gpio0 6 (GPIO_ACTIVE_HIGH | GPIO_PULL_DOWN)>,
        <&gpio0 16 (GPIO_ACTIVE_HIGH | GPIO_PULL_DOWN)>;

    col-gpios =
        <&shifter 0 GPIO_ACTIVE_HIGH>,
        <&shifter 1 GPIO_ACTIVE_HIGH>,
        <&shifter 2 GPIO_ACTIVE_HIGH>,
        <&shifter 3 GPIO_ACTIVE_HIGH>,
        <&shifter 4 GPIO_ACTIVE_HIGH>,
        <&shifter 5 GPIO_ACTIVE_HIGH>,
        <&shifter 6 GPIO_ACTIVE_HIGH>,
        <&shifter 7 GPIO_ACTIVE_HIGH>;
};
