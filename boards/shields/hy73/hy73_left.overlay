#include "hy73.dtsi"

&kscan0 {
    col-gpios =
        <&shifter 0 GPIO_ACTIVE_HIGH>,
        <&shifter 1 GPIO_ACTIVE_HIGH>,
        <&shifter 2 GPIO_ACTIVE_HIGH>,
        <&shifter 3 GPIO_ACTIVE_HIGH>,
        <&shifter 4 GPIO_ACTIVE_HIGH>,
        <&shifter 5 GPIO_ACTIVE_HIGH>;
};
