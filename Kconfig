## Kconfig
```kconfig
menu "HY0020 PoC helpers"

config HY_STATUS
    bool "HY0020 RGB status manager"
    default n
    depends on LED
    help
      Small external ZMK listener that maps standard ZMK battery and
      connection events to a Zephyr LED API RGB status LED. It does not patch
      ZMK core or implement a custom transport/driver.

if HY_STATUS

config HY_STATUS_LOW_BATTERY
    int "Low battery threshold (%)"
    range 1 99
    default 15

config HY_STATUS_CRITICAL_BATTERY
    int "Critical battery threshold (%)"
    range 1 99
    default 5

endif

endmenu
```

## boards/arm/anna_b402/Kconfig
```kconfig
config BOARD_ENABLE_DCDC
    bool "Enable ANNA-B402 nRF52833 DC/DC regulator"
    select SOC_DCDC_NRF52X
    default y
    depends on BOARD_ANNA_B402
```

## boards/arm/anna_b402/Kconfig.anna_b402
```kconfig
# u-blox ANNA-B402 board configuration

config BOARD_ANNA_B402
    select SOC_NRF52833_QIAA
```

## boards/arm/anna_b402/board.yml
```yaml
board:
    name: anna_b402
    full_name: u-blox ANNA-B402
    vendor: ublox
    socs:
        - name: nrf52833
```

## boards/arm/hy0020/Kconfig
```kconfig
config BOARD_ENABLE_DCDC
    bool "Enable HY0020 nRF52832 DC/DC regulator"
    select SOC_DCDC_NRF52X
    default y
    depends on BOARD_HY0020
    help
        Enable the nRF52832 internal DC/DC regulator. The HY0020 hardware
        must follow FDK's reference connection for DCC/DEC4 when this is on.
```

## boards/arm/hy0020/Kconfig.defconfig
```kconfig
if BOARD_HY0020

config BOARD
    default "hy0020"

config BT_CTLR
    default BT

endif # BOARD_HY0020
```

## boards/arm/hy0020/hy0020_defconfig
```kconfig
CONFIG_SOC_SERIES_NRF52X=y
CONFIG_SOC_NRF52832_QFAA=y
CONFIG_BOARD_HY0020=y
CONFIG_ARM_MPU=y
CONFIG_GPIO=y
```

## boards/shields/hy73/Kconfig.shield
```kconfig
config SHIELD_HY73_LEFT
    def_bool $(shields_list_contains,hy73_left)

config SHIELD_HY73_RIGHT
    def_bool $(shields_list_contains,hy73_right)
```

## boards/shields/hynumpad/Kconfig.defconfig
```kconfig
if SHIELD_HYNUMPAD

config ZMK_KEYBOARD_NAME
    default "HY NumPad"

config ZMK_BLE
    default y

config ZMK_BATTERY_REPORTING
    default y

endif
```
